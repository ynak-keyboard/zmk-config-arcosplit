## config/boards/shields/arcosplit/Kconfig.defconfig
```kconfig
if SHIELD_ARCOSPLIT_LEFT

config ZMK_KEYBOARD_NAME
    default "ArcoSplit"

config ZMK_SPLIT_ROLE_CENTRAL
    default y

endif

if SHIELD_ARCOSPLIT_LEFT || SHIELD_ARCOSPLIT_RIGHT

config ZMK_SPLIT
    default y

endif
```

## config/boards/shields/arcosplit/Kconfig.shield
```kconfig
config SHIELD_ARCOSPLIT_LEFT
    def_bool $(shields_list_contains,arcosplit_left)

config SHIELD_ARCOSPLIT_RIGHT
    def_bool $(shields_list_contains,arcosplit_right)
```
